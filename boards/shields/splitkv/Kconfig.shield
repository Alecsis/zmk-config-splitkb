## boards/shields/splitkv/Kconfig.shield
```kconfig
# No whitespace after the comma or in your part name!
config SHIELD_SPLIT_KV_LEFT
    def_bool $(shields_list_contains,splitkv_left)

# No whitespace after the comma or in your part name!
config SHIELD_SPLIT_KV_RIGHT
    def_bool $(shields_list_contains,splitkv_right)
```

## config/boards/shields/Kconfig.defconfig
```kconfig
config ZMK_KEYBOARD_NAME
    default "SPLIT_KB" if SHIELD_SPLIT_KB_LEFT

config ZMK_SPLIT_ROLE_CENTRAL
    default y if SHIELD_SPLIT_KB_LEFT

config ZMK_SPLIT
    default y if SHIELD_SPLIT_KB_LEFT || SHIELD_SPLIT_KB_RIGHT
```

## config/boards/shields/split_kb_left/Kconfig.shield
```kconfig
config SHIELD_SPLIT_KB_LEFT
     def_bool $(shields_list_contains,split_kb_left)
```

## config/boards/shields/split_kb_right/Kconfig.shield
```kconfig
config SHIELD_SPLIT_KB_RIGHT
     def_bool $(shields_list_contains,split_kb_right)
```
